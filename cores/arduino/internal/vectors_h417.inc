/* DO NOT EDIT - machine generated by tools/generate/generate.py
 * source: tools/generate/interrupts/interrupts.csv (variant h417)
 * Interrupt vector map. Slot 0 (reset) is emitted by crt0_ch32.S;
 * this file starts at slot 1. Verified against the EVT startup
 * sources by tests/build/startup/ on every PR. */
    CH32RV_RSV                        /*   1 reserved */
    CH32RV_IRQ NMI_Handler                     /*   2 */
    CH32RV_IRQ HardFault_Handler               /*   3 */
    CH32RV_RSV                        /*   4 reserved */
    CH32RV_IRQ Ecall_M_Mode_Handler            /*   5 */
    CH32RV_RSV                        /*   6 reserved */
    CH32RV_RSV                        /*   7 reserved */
    CH32RV_IRQ Ecall_U_Mode_Handler            /*   8 */
    CH32RV_IRQ Break_Point_Handler             /*   9 */
    CH32RV_RSV                        /*  10 reserved */
    CH32RV_RSV                        /*  11 reserved */
    CH32RV_IRQ SysTick0_Handler                /*  12 */
    CH32RV_IRQ SysTick1_Handler                /*  13 */
    CH32RV_IRQ SW_Handler                      /*  14 */
    CH32RV_RSV                        /*  15 reserved */
    CH32RV_IRQ IPC_CH0_Handler                 /*  16 */
    CH32RV_IRQ IPC_CH1_Handler                 /*  17 */
    CH32RV_IRQ IPC_CH2_Handler                 /*  18 */
    CH32RV_IRQ IPC_CH3_Handler                 /*  19 */
    CH32RV_RSV                        /*  20 reserved */
    CH32RV_RSV                        /*  21 reserved */
    CH32RV_RSV                        /*  22 reserved */
    CH32RV_RSV                        /*  23 reserved */
    CH32RV_RSV                        /*  24 reserved */
    CH32RV_RSV                        /*  25 reserved */
    CH32RV_RSV                        /*  26 reserved */
    CH32RV_RSV                        /*  27 reserved */
    CH32RV_IRQ HSEM_Handler                    /*  28 */
    CH32RV_RSV                        /*  29 reserved */
    CH32RV_RSV                        /*  30 reserved */
    CH32RV_RSV                        /*  31 reserved */
    CH32RV_IRQ WWDG_IRQHandler                 /*  32 */
    CH32RV_IRQ EXTI15_8_IRQHandler             /*  33 */
    CH32RV_IRQ FLASH_IRQHandler                /*  34 */
    CH32RV_IRQ RCC_IRQHandler                  /*  35 */
    CH32RV_IRQ EXTI7_0_IRQHandler              /*  36 */
    CH32RV_IRQ SPI1_IRQHandler                 /*  37 */
    CH32RV_IRQ DMA1_Channel2_IRQHandler        /*  38 */
    CH32RV_IRQ DMA1_Channel3_IRQHandler        /*  39 */
    CH32RV_IRQ DMA1_Channel4_IRQHandler        /*  40 */
    CH32RV_IRQ DMA1_Channel5_IRQHandler        /*  41 */
    CH32RV_IRQ DMA1_Channel6_IRQHandler        /*  42 */
    CH32RV_IRQ DMA1_Channel7_IRQHandler        /*  43 */
    CH32RV_IRQ DMA1_Channel8_IRQHandler        /*  44 */
    CH32RV_IRQ USART2_IRQHandler               /*  45 */
    CH32RV_IRQ I2C1_EV_IRQHandler              /*  46 */
    CH32RV_IRQ I2C1_ER_IRQHandler              /*  47 */
    CH32RV_IRQ USART1_IRQHandler               /*  48 */
    CH32RV_IRQ SPI2_IRQHandler                 /*  49 */
    CH32RV_IRQ SPI3_IRQHandler                 /*  50 */
    CH32RV_IRQ SPI4_IRQHandler                 /*  51 */
    CH32RV_IRQ I2C2_EV_IRQHandler              /*  52 */
    CH32RV_IRQ I2C2_ER_IRQHandler              /*  53 */
    CH32RV_IRQ USBPD_IRQHandler                /*  54 */
    CH32RV_IRQ USBPDWakeUp_IRQHandler          /*  55 */
    CH32RV_IRQ USBHS_IRQHandler                /*  56 */
    CH32RV_IRQ DMA1_Channel1_IRQHandler        /*  57 */
    CH32RV_IRQ CAN1_SCE_IRQHandler             /*  58 */
    CH32RV_IRQ CAN1_TX_IRQHandler              /*  59 */
    CH32RV_IRQ CAN1_RX0_IRQHandler             /*  60 */
    CH32RV_IRQ CAN1_RX1_IRQHandler             /*  61 */
    CH32RV_IRQ USBSS_IRQHandler                /*  62 */
    CH32RV_IRQ USBSS_LINK_IRQHandler           /*  63 */
    CH32RV_IRQ USBHSWakeup_IRQHandler          /*  64 */
    CH32RV_IRQ USBSSWakeup_IRQHandler          /*  65 */
    CH32RV_IRQ RTCAlarm_IRQHandler             /*  66 */
    CH32RV_IRQ USBFS_IRQHandler                /*  67 */
    CH32RV_IRQ USBFSWakeup_IRQHandler          /*  68 */
    CH32RV_IRQ ADC1_2_IRQHandler               /*  69 */
    CH32RV_IRQ TIM1_BRK_IRQHandler             /*  70 */
    CH32RV_IRQ TIM1_UP_IRQHandler              /*  71 */
    CH32RV_IRQ TIM1_TRG_COM_IRQHandler         /*  72 */
    CH32RV_IRQ TIM1_CC_IRQHandler              /*  73 */
    CH32RV_IRQ TIM2_IRQHandler                 /*  74 */
    CH32RV_IRQ TIM3_IRQHandler                 /*  75 */
    CH32RV_IRQ TIM4_IRQHandler                 /*  76 */
    CH32RV_IRQ TIM5_IRQHandler                 /*  77 */
    CH32RV_IRQ I2C3_EV_IRQHandler              /*  78 */
    CH32RV_IRQ I2C3_ER_IRQHandler              /*  79 */
    CH32RV_IRQ I2C4_EV_IRQHandler              /*  80 */
    CH32RV_IRQ I2C4_ER_IRQHandler              /*  81 */
    CH32RV_IRQ QSPI1_IRQHandler                /*  82 */
    CH32RV_IRQ SERDES_IRQHandler               /*  83 */
    CH32RV_IRQ USART3_IRQHandler               /*  84 */
    CH32RV_IRQ USART4_IRQHandler               /*  85 */
    CH32RV_IRQ TIM8_BRK_IRQHandler             /*  86 */
    CH32RV_IRQ TIM8_UP_IRQHandler              /*  87 */
    CH32RV_IRQ TIM8_TRG_COM_IRQHandler         /*  88 */
    CH32RV_IRQ TIM8_CC_IRQHandler              /*  89 */
    CH32RV_IRQ TIM9_IRQHandler                 /*  90 */
    CH32RV_IRQ TIM10_IRQHandler                /*  91 */
    CH32RV_IRQ TIM11_IRQHandler                /*  92 */
    CH32RV_IRQ TIM12_IRQHandler                /*  93 */
    CH32RV_IRQ FMC_IRQHandler                  /*  94 */
    CH32RV_IRQ SDMMC_IRQHandler                /*  95 */
    CH32RV_IRQ LPTIM1_IRQHandler               /*  96 */
    CH32RV_IRQ LPTIM2_IRQHandler               /*  97 */
    CH32RV_IRQ USART5_IRQHandler               /*  98 */
    CH32RV_IRQ USART6_IRQHandler               /*  99 */
    CH32RV_IRQ TIM6_IRQHandler                 /* 100 */
    CH32RV_IRQ TIM7_IRQHandler                 /* 101 */
    CH32RV_IRQ DMA2_Channel1_IRQHandler        /* 102 */
    CH32RV_IRQ DMA2_Channel2_IRQHandler        /* 103 */
    CH32RV_IRQ DMA2_Channel3_IRQHandler        /* 104 */
    CH32RV_IRQ DMA2_Channel4_IRQHandler        /* 105 */
    CH32RV_IRQ DMA2_Channel5_IRQHandler        /* 106 */
    CH32RV_IRQ DMA2_Channel6_IRQHandler        /* 107 */
    CH32RV_IRQ DMA2_Channel7_IRQHandler        /* 108 */
    CH32RV_IRQ DMA2_Channel8_IRQHandler        /* 109 */
    CH32RV_IRQ ETH_IRQHandler                  /* 110 */
    CH32RV_IRQ ETH_WKUP_IRQHandler             /* 111 */
    CH32RV_IRQ CAN2_SCE_IRQHandler             /* 112 */
    CH32RV_IRQ CAN2_TX_IRQHandler              /* 113 */
    CH32RV_IRQ CAN2_RX0_IRQHandler             /* 114 */
    CH32RV_IRQ CAN2_RX1_IRQHandler             /* 115 */
    CH32RV_IRQ USART7_IRQHandler               /* 116 */
    CH32RV_IRQ USART8_IRQHandler               /* 117 */
    CH32RV_IRQ I3C_EV_IRQHandler               /* 118 */
    CH32RV_IRQ I3C_ER_IRQHandler               /* 119 */
    CH32RV_IRQ DVP_IRQHandler                  /* 120 */
    CH32RV_IRQ ECDC_IRQHandler                 /* 121 */
    CH32RV_IRQ PIOC_IRQHandler                 /* 122 */
    CH32RV_IRQ SAI_IRQHandler                  /* 123 */
    CH32RV_IRQ LTDC_IRQHandler                 /* 124 */
    CH32RV_IRQ GPHA_IRQHandler                 /* 125 */
    CH32RV_RSV                        /* 126 reserved */
    CH32RV_IRQ DFSDM0_IRQHandler               /* 127 */
    CH32RV_IRQ DFSDM1_IRQHandler               /* 128 */
    CH32RV_RSV                        /* 129 reserved */
    CH32RV_RSV                        /* 130 reserved */
    CH32RV_IRQ SWPMI_IRQHandler                /* 131 */
    CH32RV_RSV                        /* 132 reserved */
    CH32RV_RSV                        /* 133 reserved */
    CH32RV_IRQ QSPI2_IRQHandler                /* 134 */
    CH32RV_IRQ SWPMI_WKUP_IRQHandler           /* 135 */
    CH32RV_IRQ CAN3_SCE_IRQHandler             /* 136 */
    CH32RV_IRQ CAN3_TX_IRQHandler              /* 137 */
    CH32RV_IRQ CAN3_RX0_IRQHandler             /* 138 */
    CH32RV_IRQ CAN3_RX1_IRQHandler             /* 139 */
    CH32RV_IRQ LPTIM2_WKUP_IRQHandler          /* 140 */
    CH32RV_IRQ LPTIM1_WKUP_IRQHandler          /* 141 */
    CH32RV_IRQ I3C_WKUP_IRQHandler             /* 142 */
    CH32RV_IRQ RTC_IRQHandler                  /* 143 */
    CH32RV_IRQ HSADC_IRQHandler                /* 144 */
    CH32RV_IRQ UHSIF_IRQHandler                /* 145 */
    CH32RV_IRQ RNG_IRQHandler                  /* 146 */
    CH32RV_IRQ SDIO_IRQHandler                 /* 147 */
    CH32RV_IRQ USART_WKUP_IRQHandler           /* 148 */
