/* DO NOT EDIT - machine generated by tools/generate/generate.py
 * source: tools/generate/interrupts/interrupts.csv (variant v003)
 * Interrupt vector map. Slot 0 (reset) is emitted by crt0_ch32.S;
 * this file starts at slot 1. Verified against the EVT startup
 * sources by tests/build/startup/ on every PR. */
    CH32RV_RSV                        /*   1 reserved */
    CH32RV_IRQ NMI_Handler                     /*   2 */
    CH32RV_IRQ HardFault_Handler               /*   3 */
    CH32RV_RSV                        /*   4 reserved */
    CH32RV_RSV                        /*   5 reserved */
    CH32RV_RSV                        /*   6 reserved */
    CH32RV_RSV                        /*   7 reserved */
    CH32RV_RSV                        /*   8 reserved */
    CH32RV_RSV                        /*   9 reserved */
    CH32RV_RSV                        /*  10 reserved */
    CH32RV_RSV                        /*  11 reserved */
    CH32RV_IRQ SysTick_Handler                 /*  12 */
    CH32RV_RSV                        /*  13 reserved */
    CH32RV_IRQ SW_Handler                      /*  14 */
    CH32RV_RSV                        /*  15 reserved */
    CH32RV_IRQ WWDG_IRQHandler                 /*  16 */
    CH32RV_IRQ PVD_IRQHandler                  /*  17 */
    CH32RV_IRQ FLASH_IRQHandler                /*  18 */
    CH32RV_IRQ RCC_IRQHandler                  /*  19 */
    CH32RV_IRQ EXTI7_0_IRQHandler              /*  20 */
    CH32RV_IRQ AWU_IRQHandler                  /*  21 */
    CH32RV_IRQ DMA1_Channel1_IRQHandler        /*  22 */
    CH32RV_IRQ DMA1_Channel2_IRQHandler        /*  23 */
    CH32RV_IRQ DMA1_Channel3_IRQHandler        /*  24 */
    CH32RV_IRQ DMA1_Channel4_IRQHandler        /*  25 */
    CH32RV_IRQ DMA1_Channel5_IRQHandler        /*  26 */
    CH32RV_IRQ DMA1_Channel6_IRQHandler        /*  27 */
    CH32RV_IRQ DMA1_Channel7_IRQHandler        /*  28 */
    CH32RV_IRQ ADC1_IRQHandler                 /*  29 */
    CH32RV_IRQ I2C1_EV_IRQHandler              /*  30 */
    CH32RV_IRQ I2C1_ER_IRQHandler              /*  31 */
    CH32RV_IRQ USART1_IRQHandler               /*  32 */
    CH32RV_IRQ SPI1_IRQHandler                 /*  33 */
    CH32RV_IRQ TIM1_BRK_IRQHandler             /*  34 */
    CH32RV_IRQ TIM1_UP_IRQHandler              /*  35 */
    CH32RV_IRQ TIM1_TRG_COM_IRQHandler         /*  36 */
    CH32RV_IRQ TIM1_CC_IRQHandler              /*  37 */
    CH32RV_IRQ TIM2_IRQHandler                 /*  38 */
