/* DO NOT EDIT - machine generated by tools/generate/generate.py
 * source: tools/generate/interrupts/interrupts.csv (variant v103)
 * Interrupt vector map. Slot 0 (reset) is emitted by crt0_ch32.S;
 * this file starts at slot 1. Verified against the EVT startup
 * sources by tests/startup/ on every PR. */
    CH32_RSV                          /*   1 reserved */
    CH32_JMP NMI_Handler                       /*   2 */
    CH32_JMP HardFault_Handler                 /*   3 */
    CH32_RSV                          /*   4 reserved */
    CH32_RSV                          /*   5 reserved */
    CH32_RSV                          /*   6 reserved */
    CH32_RSV                          /*   7 reserved */
    CH32_RSV                          /*   8 reserved */
    CH32_RSV                          /*   9 reserved */
    CH32_RSV                          /*  10 reserved */
    CH32_RSV                          /*  11 reserved */
    CH32_JMP SysTick_Handler                   /*  12 */
    CH32_RSV                          /*  13 reserved */
    CH32_JMP SW_Handler                        /*  14 */
    CH32_RSV                          /*  15 reserved */
    CH32_JMP WWDG_IRQHandler                   /*  16 */
    CH32_JMP PVD_IRQHandler                    /*  17 */
    CH32_JMP TAMPER_IRQHandler                 /*  18 */
    CH32_JMP RTC_IRQHandler                    /*  19 */
    CH32_JMP FLASH_IRQHandler                  /*  20 */
    CH32_JMP RCC_IRQHandler                    /*  21 */
    CH32_JMP EXTI0_IRQHandler                  /*  22 */
    CH32_JMP EXTI1_IRQHandler                  /*  23 */
    CH32_JMP EXTI2_IRQHandler                  /*  24 */
    CH32_JMP EXTI3_IRQHandler                  /*  25 */
    CH32_JMP EXTI4_IRQHandler                  /*  26 */
    CH32_JMP DMA1_Channel1_IRQHandler          /*  27 */
    CH32_JMP DMA1_Channel2_IRQHandler          /*  28 */
    CH32_JMP DMA1_Channel3_IRQHandler          /*  29 */
    CH32_JMP DMA1_Channel4_IRQHandler          /*  30 */
    CH32_JMP DMA1_Channel5_IRQHandler          /*  31 */
    CH32_JMP DMA1_Channel6_IRQHandler          /*  32 */
    CH32_JMP DMA1_Channel7_IRQHandler          /*  33 */
    CH32_JMP ADC1_2_IRQHandler                 /*  34 */
    CH32_RSV                          /*  35 reserved */
    CH32_RSV                          /*  36 reserved */
    CH32_RSV                          /*  37 reserved */
    CH32_RSV                          /*  38 reserved */
    CH32_JMP EXTI9_5_IRQHandler                /*  39 */
    CH32_JMP TIM1_BRK_IRQHandler               /*  40 */
    CH32_JMP TIM1_UP_IRQHandler                /*  41 */
    CH32_JMP TIM1_TRG_COM_IRQHandler           /*  42 */
    CH32_JMP TIM1_CC_IRQHandler                /*  43 */
    CH32_JMP TIM2_IRQHandler                   /*  44 */
    CH32_JMP TIM3_IRQHandler                   /*  45 */
    CH32_JMP TIM4_IRQHandler                   /*  46 */
    CH32_JMP I2C1_EV_IRQHandler                /*  47 */
    CH32_JMP I2C1_ER_IRQHandler                /*  48 */
    CH32_JMP I2C2_EV_IRQHandler                /*  49 */
    CH32_JMP I2C2_ER_IRQHandler                /*  50 */
    CH32_JMP SPI1_IRQHandler                   /*  51 */
    CH32_JMP SPI2_IRQHandler                   /*  52 */
    CH32_JMP USART1_IRQHandler                 /*  53 */
    CH32_JMP USART2_IRQHandler                 /*  54 */
    CH32_JMP USART3_IRQHandler                 /*  55 */
    CH32_JMP EXTI15_10_IRQHandler              /*  56 */
    CH32_JMP RTCAlarm_IRQHandler               /*  57 */
    CH32_JMP USBWakeUp_IRQHandler              /*  58 */
    CH32_JMP USBFS_IRQHandler                  /*  59 */
