/* DO NOT EDIT - machine generated by tools/generate/generate.py
 * source: tools/generate/interrupts/interrupts.csv (variant v307_d8c)
 * Interrupt vector map. Slot 0 (reset) is emitted by crt0_ch32.S;
 * this file starts at slot 1. Verified against the EVT startup
 * sources by tests/startup/ on every PR. */
    CH32_RSV                            /*   1 reserved */
    CH32_IRQ NMI_Handler                         /*   2 */
    CH32_IRQ HardFault_Handler                   /*   3 */
    CH32_RSV                            /*   4 reserved */
    CH32_IRQ Ecall_M_Mode_Handler                /*   5 */
    CH32_RSV                            /*   6 reserved */
    CH32_RSV                            /*   7 reserved */
    CH32_IRQ Ecall_U_Mode_Handler                /*   8 */
    CH32_IRQ Break_Point_Handler                 /*   9 */
    CH32_RSV                            /*  10 reserved */
    CH32_RSV                            /*  11 reserved */
    CH32_IRQ SysTick_Handler                     /*  12 */
    CH32_RSV                            /*  13 reserved */
    CH32_IRQ SW_Handler                          /*  14 */
    CH32_RSV                            /*  15 reserved */
    CH32_IRQ WWDG_IRQHandler                     /*  16 */
    CH32_IRQ PVD_IRQHandler                      /*  17 */
    CH32_IRQ TAMPER_IRQHandler                   /*  18 */
    CH32_IRQ RTC_IRQHandler                      /*  19 */
    CH32_IRQ FLASH_IRQHandler                    /*  20 */
    CH32_IRQ RCC_IRQHandler                      /*  21 */
    CH32_IRQ EXTI0_IRQHandler                    /*  22 */
    CH32_IRQ EXTI1_IRQHandler                    /*  23 */
    CH32_IRQ EXTI2_IRQHandler                    /*  24 */
    CH32_IRQ EXTI3_IRQHandler                    /*  25 */
    CH32_IRQ EXTI4_IRQHandler                    /*  26 */
    CH32_IRQ DMA1_Channel1_IRQHandler            /*  27 */
    CH32_IRQ DMA1_Channel2_IRQHandler            /*  28 */
    CH32_IRQ DMA1_Channel3_IRQHandler            /*  29 */
    CH32_IRQ DMA1_Channel4_IRQHandler            /*  30 */
    CH32_IRQ DMA1_Channel5_IRQHandler            /*  31 */
    CH32_IRQ DMA1_Channel6_IRQHandler            /*  32 */
    CH32_IRQ DMA1_Channel7_IRQHandler            /*  33 */
    CH32_IRQ ADC1_2_IRQHandler                   /*  34 */
    CH32_IRQ USB_HP_CAN1_TX_IRQHandler           /*  35 */
    CH32_IRQ USB_LP_CAN1_RX0_IRQHandler          /*  36 */
    CH32_IRQ CAN1_RX1_IRQHandler                 /*  37 */
    CH32_IRQ CAN1_SCE_IRQHandler                 /*  38 */
    CH32_IRQ EXTI9_5_IRQHandler                  /*  39 */
    CH32_IRQ TIM1_BRK_IRQHandler                 /*  40 */
    CH32_IRQ TIM1_UP_IRQHandler                  /*  41 */
    CH32_IRQ TIM1_TRG_COM_IRQHandler             /*  42 */
    CH32_IRQ TIM1_CC_IRQHandler                  /*  43 */
    CH32_IRQ TIM2_IRQHandler                     /*  44 */
    CH32_IRQ TIM3_IRQHandler                     /*  45 */
    CH32_IRQ TIM4_IRQHandler                     /*  46 */
    CH32_IRQ I2C1_EV_IRQHandler                  /*  47 */
    CH32_IRQ I2C1_ER_IRQHandler                  /*  48 */
    CH32_IRQ I2C2_EV_IRQHandler                  /*  49 */
    CH32_IRQ I2C2_ER_IRQHandler                  /*  50 */
    CH32_IRQ SPI1_IRQHandler                     /*  51 */
    CH32_IRQ SPI2_IRQHandler                     /*  52 */
    CH32_IRQ USART1_IRQHandler                   /*  53 */
    CH32_IRQ USART2_IRQHandler                   /*  54 */
    CH32_IRQ USART3_IRQHandler                   /*  55 */
    CH32_IRQ EXTI15_10_IRQHandler                /*  56 */
    CH32_IRQ RTCAlarm_IRQHandler                 /*  57 */
    CH32_IRQ USBWakeUp_IRQHandler                /*  58 */
    CH32_IRQ TIM8_BRK_IRQHandler                 /*  59 */
    CH32_IRQ TIM8_UP_IRQHandler                  /*  60 */
    CH32_IRQ TIM8_TRG_COM_IRQHandler             /*  61 */
    CH32_IRQ TIM8_CC_IRQHandler                  /*  62 */
    CH32_IRQ RNG_IRQHandler                      /*  63 */
    CH32_RSV                            /*  64 reserved */
    CH32_IRQ SDIO_IRQHandler                     /*  65 */
    CH32_IRQ TIM5_IRQHandler                     /*  66 */
    CH32_IRQ SPI3_IRQHandler                     /*  67 */
    CH32_IRQ UART4_IRQHandler                    /*  68 */
    CH32_IRQ UART5_IRQHandler                    /*  69 */
    CH32_IRQ TIM6_IRQHandler                     /*  70 */
    CH32_IRQ TIM7_IRQHandler                     /*  71 */
    CH32_IRQ DMA2_Channel1_IRQHandler            /*  72 */
    CH32_IRQ DMA2_Channel2_IRQHandler            /*  73 */
    CH32_IRQ DMA2_Channel3_IRQHandler            /*  74 */
    CH32_IRQ DMA2_Channel4_IRQHandler            /*  75 */
    CH32_IRQ DMA2_Channel5_IRQHandler            /*  76 */
    CH32_IRQ ETH_IRQHandler                      /*  77 */
    CH32_IRQ ETH_WKUP_IRQHandler                 /*  78 */
    CH32_IRQ CAN2_TX_IRQHandler                  /*  79 */
    CH32_IRQ CAN2_RX0_IRQHandler                 /*  80 */
    CH32_IRQ CAN2_RX1_IRQHandler                 /*  81 */
    CH32_IRQ CAN2_SCE_IRQHandler                 /*  82 */
    CH32_IRQ USBFS_IRQHandler                    /*  83 */
    CH32_IRQ USBHSWakeup_IRQHandler              /*  84 */
    CH32_IRQ USBHS_IRQHandler                    /*  85 */
    CH32_IRQ DVP_IRQHandler                      /*  86 */
    CH32_IRQ UART6_IRQHandler                    /*  87 */
    CH32_IRQ UART7_IRQHandler                    /*  88 */
    CH32_IRQ UART8_IRQHandler                    /*  89 */
    CH32_IRQ TIM9_BRK_IRQHandler                 /*  90 */
    CH32_IRQ TIM9_UP_IRQHandler                  /*  91 */
    CH32_IRQ TIM9_TRG_COM_IRQHandler             /*  92 */
    CH32_IRQ TIM9_CC_IRQHandler                  /*  93 */
    CH32_IRQ TIM10_BRK_IRQHandler                /*  94 */
    CH32_IRQ TIM10_UP_IRQHandler                 /*  95 */
    CH32_IRQ TIM10_TRG_COM_IRQHandler            /*  96 */
    CH32_IRQ TIM10_CC_IRQHandler                 /*  97 */
    CH32_IRQ DMA2_Channel6_IRQHandler            /*  98 */
    CH32_IRQ DMA2_Channel7_IRQHandler            /*  99 */
    CH32_IRQ DMA2_Channel8_IRQHandler            /* 100 */
    CH32_IRQ DMA2_Channel9_IRQHandler            /* 101 */
    CH32_IRQ DMA2_Channel10_IRQHandler           /* 102 */
    CH32_IRQ DMA2_Channel11_IRQHandler           /* 103 */
