/* DO NOT EDIT - machine generated by tools/generate/generate.py
 * source: tools/generate/interrupts/interrupts.csv (variant x3x5)
 * Interrupt vector map. Slot 0 (reset) is emitted by crt0_ch32.S;
 * this file starts at slot 1. Verified against the EVT startup
 * sources by tests/build/startup/ on every PR. */
    CH32RV_RSV                         /*   1 reserved */
    CH32RV_IRQ NMI_Handler                      /*   2 */
    CH32RV_IRQ HardFault_Handler                /*   3 */
    CH32RV_RSV                         /*   4 reserved */
    CH32RV_IRQ Ecall_M_Mode_Handler             /*   5 */
    CH32RV_RSV                         /*   6 reserved */
    CH32RV_RSV                         /*   7 reserved */
    CH32RV_IRQ Ecall_U_Mode_Handler             /*   8 */
    CH32RV_IRQ Break_Point_Handler              /*   9 */
    CH32RV_RSV                         /*  10 reserved */
    CH32RV_RSV                         /*  11 reserved */
    CH32RV_IRQ SysTick_Handler                  /*  12 */
    CH32RV_RSV                         /*  13 reserved */
    CH32RV_IRQ SW_Handler                       /*  14 */
    CH32RV_RSV                         /*  15 reserved */
    CH32RV_IRQ WWDG_IRQHandler                  /*  16 */
    CH32RV_IRQ EXTI15_8_IRQHandler              /*  17 */
    CH32RV_IRQ FLASH_IRQHandler                 /*  18 */
    CH32RV_IRQ RCC_IRQHandler                   /*  19 */
    CH32RV_IRQ EXTI7_0_IRQHandler               /*  20 */
    CH32RV_IRQ SPI2_IRQHandler                  /*  21 */
    CH32RV_IRQ DMA1_Channel1_IRQHandler         /*  22 */
    CH32RV_IRQ DMA1_Channel2_IRQHandler         /*  23 */
    CH32RV_IRQ DMA1_Channel3_IRQHandler         /*  24 */
    CH32RV_IRQ DMA1_Channel4_IRQHandler         /*  25 */
    CH32RV_IRQ DMA1_Channel5_IRQHandler         /*  26 */
    CH32RV_IRQ DMA1_Channel6_IRQHandler         /*  27 */
    CH32RV_IRQ DMA1_Channel7_IRQHandler         /*  28 */
    CH32RV_IRQ DMA1_Channel8_IRQHandler         /*  29 */
    CH32RV_IRQ DMA1_Channel9_IRQHandler         /*  30 */
    CH32RV_IRQ DMA1_Channel10_IRQHandler        /*  31 */
    CH32RV_IRQ DMA1_Channel11_IRQHandler        /*  32 */
    CH32RV_IRQ USART2_IRQHandler                /*  33 */
    CH32RV_IRQ I2C1_EV_IRQHandler               /*  34 */
    CH32RV_IRQ I2C1_ER_IRQHandler               /*  35 */
    CH32RV_IRQ USART1_IRQHandler                /*  36 */
    CH32RV_IRQ SPI1_IRQHandler                  /*  37 */
    CH32RV_IRQ TIM1_UP_IRQHandler               /*  38 */
    CH32RV_IRQ TIM1_CC_IRQHandler               /*  39 */
    CH32RV_IRQ TIM1_TRG_COM_IRQHandler          /*  40 */
    CH32RV_IRQ TIM1_BRK_IRQHandler              /*  41 */
    CH32RV_IRQ TIM2_IRQHandler                  /*  42 */
    CH32RV_IRQ I2C2_EV_IRQHandler               /*  43 */
    CH32RV_IRQ I2C2_ER_IRQHandler               /*  44 */
    CH32RV_IRQ USBPD_IRQHandler                 /*  45 */
    CH32RV_IRQ USBPDWakeUp_IRQHandler           /*  46 */
    CH32RV_IRQ ARGB_IRQHandler                  /*  47 */
    CH32RV_IRQ TIM3_IRQHandler                  /*  48 */
    CH32RV_IRQ TIM4_IRQHandler                  /*  49 */
    CH32RV_IRQ SPI3_IRQHandler                  /*  50 */
    CH32RV_IRQ USART3_IRQHandler                /*  51 */
    CH32RV_IRQ USART4_IRQHandler                /*  52 */
    CH32RV_IRQ USBSS_IRQHandler                 /*  53 */
    CH32RV_IRQ USBSS_LINK_IRQHandler            /*  54 */
    CH32RV_IRQ USBHS_IRQHandler                 /*  55 */
    CH32RV_IRQ USBHSWakeup_IRQHandler           /*  56 */
    CH32RV_IRQ USBSSWakeup_IRQHandler           /*  57 */
    CH32RV_IRQ PVD_IRQHandler                   /*  58 */
    CH32RV_IRQ ADC1_IRQHandler                  /*  59 */
    CH32RV_IRQ ADC2_IRQHandler                  /*  60 */
    CH32RV_IRQ ADC3_IRQHandler                  /*  61 */
    CH32RV_IRQ RTCAlarm_IRQHandler              /*  62 */
    CH32RV_IRQ RTC_IRQHandler                   /*  63 */
    CH32RV_IRQ USART_WKUP_IRQHandler            /*  64 */
    CH32RV_IRQ ADC4_IRQHandler                  /*  65 */
