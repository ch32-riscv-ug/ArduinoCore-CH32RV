/* DO NOT EDIT - machine generated by prototypes/generator/generate.py
 * source: ch32-device-data tables @ git 8c09ab446f510a1ab056dad4c7f3ae5fbdc91ad9 */
/* FLASH 32K, SRAM 6K */
ENTRY( _start )

MEMORY
{
    FLASH (rx) : ORIGIN = 0x00000000, LENGTH = 32768
    RAM (xrw)  : ORIGIN = 0x20000000, LENGTH = 6144
}

INCLUDE sections.ld
