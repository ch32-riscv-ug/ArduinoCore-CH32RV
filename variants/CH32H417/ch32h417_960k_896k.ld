/* DO NOT EDIT - machine generated by tools/generate/generate.py
 * source: ch32-riscv-ug/ch32-device-data tables, pinned in vendor/ch32-device-data.lock.toml */
/* FLASH 960K, SRAM 896K, of which the 512K at
 * 0x20100000 holds the code and the data (CH32RV_LOADCODE) */
ENTRY( _start )

MEMORY
{
    FLASH (rx) : ORIGIN = 0x00000000, LENGTH = 983040
    RAM (xrw)  : ORIGIN = 0x20100000, LENGTH = 524288
}

INCLUDE sections_loadcode.ld
