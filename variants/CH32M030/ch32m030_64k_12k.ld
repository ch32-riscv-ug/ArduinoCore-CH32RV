/* DO NOT EDIT - machine generated by tools/generate/generate.py
 * source: ch32-device-data tables @ git 0a1eed7b2e00066438a2ed25c2dce5aeca91bc18 */
/* FLASH 64K, SRAM 12K */
ENTRY( _start )

MEMORY
{
    FLASH (rx) : ORIGIN = 0x00000000, LENGTH = 65536
    RAM (xrw)  : ORIGIN = 0x20000000, LENGTH = 12288
}

INCLUDE sections.ld
