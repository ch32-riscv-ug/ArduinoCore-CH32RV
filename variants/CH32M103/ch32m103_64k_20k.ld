/* DO NOT EDIT - machine generated by tools/generate/generate.py
 * source: ch32-device-data tables @ git 66a421f41207c1110188e1dc0ecced98fa026026 */
/* FLASH 64K, SRAM 20K */
ENTRY( _start )

MEMORY
{
    FLASH (rx) : ORIGIN = 0x00000000, LENGTH = 65536
    RAM (xrw)  : ORIGIN = 0x20000000, LENGTH = 20480
}

INCLUDE sections.ld
