/* DO NOT EDIT - machine generated by tools/generate/generate.py
 * source: ch32-device-data tables @ git 66a421f41207c1110188e1dc0ecced98fa026026 */
/* FLASH 256K, SRAM 32K */
ENTRY( _start )

MEMORY
{
    FLASH (rx) : ORIGIN = 0x00000000, LENGTH = 262144
    RAM (xrw)  : ORIGIN = 0x20000000, LENGTH = 32768
}

INCLUDE sections.ld
