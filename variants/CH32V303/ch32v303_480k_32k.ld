/* DO NOT EDIT - machine generated by tools/generate/generate.py
 * source: ch32-riscv-ug/ch32-device-data tables, pinned in vendor/ch32-device-data.lock.toml */
/* FLASH 480K, SRAM 32K */
ENTRY( _start )

MEMORY
{
    FLASH (rx) : ORIGIN = 0x00000000, LENGTH = 491520
    RAM (xrw)  : ORIGIN = 0x20000000, LENGTH = 32768
}

INCLUDE sections.ld
