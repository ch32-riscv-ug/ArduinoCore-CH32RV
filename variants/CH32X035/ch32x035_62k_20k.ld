/* DO NOT EDIT - machine generated by tools/generate/generate.py
 * source: ch32-device-data tables @ git 0a1eed7b2e00066438a2ed25c2dce5aeca91bc18 */
/* FLASH 62K, SRAM 20K */
ENTRY( _start )

MEMORY
{
    FLASH (rx) : ORIGIN = 0x00000000, LENGTH = 63488
    RAM (xrw)  : ORIGIN = 0x20000000, LENGTH = 20480
}

INCLUDE sections.ld
